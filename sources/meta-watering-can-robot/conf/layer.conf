## sources/meta-watering-can-robot/conf/layer.conf
```bitbake
# We have a conf and classes directory, add to BBPATH
BBPATH .= ":${LAYERDIR}"

# We have recipes-* directories, add to BBFILES
BBFILES += "${LAYERDIR}/recipes-*/*/*.bb \
            ${LAYERDIR}/recipes-*/*/*.bbappend"

BBFILE_COLLECTIONS += "watering-can-robot-layer"
BBFILE_PATTERN_watering-can-robot-layer = "^${LAYERDIR}/"
## BOTE: We can change later the priority, but meta-watering-can-robot must be build last
BBFILE_PRIORITY_watering-can-robot-layer = "99"

LAYERSERIES_COMPAT_watering-can-robot-layer = "honister"
```
